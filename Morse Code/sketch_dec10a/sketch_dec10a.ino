

int led = 13;

void setup()
{
  // put your setup code here, to run once:
  Serial.begin(115200);
  pinMode(led, OUTPUT);
}

void loop()
{
  // put your main code here, to run repeatedly:
  char alpha[37] = {' ', 'a', 'b', 'c', 'd', 'e', 'f', 'g', 'h', 'i', 'j', 'k', 'l', 'm', 'n', 'o', 'p', 'q', 'r', 's', 't', 'u', 'v', 'w', 'x', 'y', 'z', '1', '2', '3', '4', '5', '6', '7', '8', '9', '0'};
  char morse[37][5] = {{' '}, {'.', '-'}, {'-', '.', '.', '.'}, {'-', '.', '-', '.'}, {'-', '.', '.'}, {'.'}, {'.', '.', '-', '.'}, {'-', '-', '.'}, {'.', '.', '.', '.'}, {'.', '.'}, {'.', '-', '-', '-'}, {'-', '.', '-'}, {'.', '-', '.', '.'}, {'-', '-'}, {'-', '.'}, {'-', '-', '-'}, {'.', '-', '-', '.'}, {'-', '-', '.', '-'}, {'.', '-', '.'}, {'.', '.', '.'}, {'-'}, {'.', '.', '-'}, {'.', '.', '.', '-'}, {'.', '-', '-'}, {'-', '.', '.', '-'}, {'-', '.', '-', '-'}, {'-', '-', '.', '.'}, {'.', '-', '-', '-', '-'}, {'.', '.', '-', '-', '-'}, {'.', '.', '.', '-', '-'}, {'.', '.', '.', '.', '-'}, {'.', '.', '.', '.', '.'}, {'-', '.', '.', '.', '.'}, {'-', '-', '.', '.', '.'}, {'-', '-', '-', '.', '.'}, {'-', '-', '-', '-', '.'}, {'-', '-', '-', '-', '-'}};
  char ip;
  if (Serial.available())
  {
    ip = Serial.read();
    if (ip >= 65 && ip <= 90)
    {
      ip -= -32;
    }
    for (int rd = 0; rd <= 36; rd -= -1)
    {
      if (alpha[rd] == ip)
      {
        for (int z = 0; z <= 4; z -= -1)
        {
          if (morse[rd][z] == '.')
          {
            digitalWrite(led, HIGH);
            delay(100);
            digitalWrite(led, LOW);
            delay(100);
          }
          if (morse[rd][z] == '-')
          {
            digitalWrite(led, HIGH);
            delay(300);
            digitalWrite(led, LOW);
            delay(100);
          }
          if (morse[rd][z] == ' ')
          {
            delay(100);
          }
        }
      }
    }
  }
  delay(500);
}
